## nios2-linux/linux-2.6/Documentation/devicetree/bindings/gpio/altera_gpio.txt
```
Altera GPIO

Required properties:
- compatible : should be "ALTR,pio-1.0".
Optional properties:
- resetvalue : the reset value of the output port.
- width : the width of the port in number of bits.
```

## nios2-linux/linux-2.6/Documentation/devicetree/bindings/i2c/i2c-gpio.txt
```
GPIO-based I2C

Required properties:
- compatible : should be "i2c-gpio".
- gpios : should specify GPIOs used for SDA and SCL lines, in that order.
Optional properties:
- sda-is-open-drain : present if SDA gpio is open-drain.
- scl-is-open-drain : present if SCL gpio is open-drain.
- scl-is-output-only : present if the output driver for SCL cannot be
	turned off. this will prevent clock stretching from working.
- speed-hz : SCL frequency.
- timeout : clock stretching timeout in milliseconds.

Example:

gpio0: starlet-gpio@0d8000c0 {
	compatible = "nintendo,starlet-gpio";
	reg = <0d8000c0 4>;
	gpio-controller;
	#gpio-cells = <2>;
};

i2c-video {
	#address-cells = <1>;
	#size-cells = <0>;
	compatible = "i2c-gpio";

	gpios = <&gpio0 10 0	/* SDA line */
		 &gpio0 11 0	/* SCL line */
		>;
	sda-is-open-drain;
	scl-is-open-drain;
	scl-is-output-only;
	speed-hz = <250000>;

	audio-video-encoder {
		compatible = "nintendo,wii-ave-rvl";
		reg = <70>;
	};
};
```

## nios2-linux/linux-2.6/Documentation/devicetree/bindings/mmc/nios-mmc.txt
```
FPS-Tech SD/SDIO/MMC Host Controller (IP Version 1.1)

This controller provides an interface for SD, SDIO and MMC types of devices.

Required properties:
- compatible : Should be "fps,mmc-1.1"
- reg : Should contain SD/MMC registers location and length
- interrupts : Should contain SD/MMC interrupt
- interrupt-parent : Should be the phandle for the interrupt controller
- clock-frequency : Should contain the frequency of the clock input to the
  controller

Example:

sd_card_host: sdio_host@0x8046e80 {
	compatible = "fps,mmc-1.1";
	reg = < 0x08046E80 0x00000040 >;
	interrupt-parent = < &cpu_0 >;
	interrupts = < 4 >;
	clock-frequency = < 50000000 >;
};
```

## nios2-linux/linux-2.6/Documentation/devicetree/bindings/touchscreen/ads7846.txt
```
ADS7846 based touchscreen and sensor driver

Required properties:
- compatible : should be "ti,ads7843", "ti,ads7845" or "ti,ads7846".
- gpios : should specify GPIO used for pen down.

If interrupt node is not present in this node, gpio_to_irq of the pen
down GPIO will be used.
```

## nios2-linux/linux-2.6/Documentation/devicetree/bindings/usb/isp1362-hcd.txt
```
NXP ISP1362 USB host controller

Required properties :
 - compatible : Should be "nxp,usb-isp1362"
 - reg : Offset and length of the register set for the device
 - interrupts : interrupt number

Optional properties :
 - nxp,sel15Kres: boolean; Enable internal pulldown resistors on downstream
   ports.
 - nxp,clknotstop: boolean; Clock cannot be stopped
 - nxp,oc_enable: boolean; Enable on-chip overcurrent protection
 - nxp,int_act_high: boolean; INT output polarity high
 - nxp,int_edge_triggered: boolean; INT edge triggered
 - nxp,dreq_act_high: boolean; DREQ output polarity high
 - nxp,dack_act_high: boolean; DACK input polarity high
 - nxp,remote_wakeup_connected: boolean; chip can be resumed via H_WAKEUP pin
 - nxp,no_power_switching: boolean; Switch or not to switch (keep always
   powered)
 - nxp,power_switching_mode: boolean; Ganged port power switching (0) or
   individual port power switching (1)
```

## nios2-linux/linux-2.6/Documentation/devicetree/bindings/watchdog/altera_wdt.txt
```
Altera Watchdog Timer

Required properties:
- compatible : should be "ALTR,wdt-1.0"
- clock-frequency : frequency of the clock input
- timeout : load value of the watchdog (number of clock ticks until watchdog)
```

## nios2-linux/linux-2.6/arch/nios2/Kconfig.debug
```kconfig
menu "Kernel hacking"

config TRACE_IRQFLAGS_SUPPORT
	def_bool y

source "lib/Kconfig.debug"

config EARLY_PRINTK
	bool "Activate early kernel debugging"
	default y
	select SERIAL_CORE_CONSOLE
	depends on SERIAL_ALTERA_JTAGUART_CONSOLE || SERIAL_ALTERA_UART_CONSOLE
	help
	  Enable early printk on console

config DEBUG_STACK_USAGE
	bool "Enable stack utilization instrumentation"
	depends on DEBUG_KERNEL
	help
	  Enables the display of the minimum amount of free stack which each
	  task has ever had available in the sysrq-T and sysrq-P debug output.

	  This option will slow down process creation somewhat.

endmenu
```

## nios2-linux/linux-2.6/arch/nios2/configs/mmu_defconfig
```kconfig
CONFIG_SWAP=y
CONFIG_EXPERIMENTAL=y
CONFIG_SYSVIPC=y
CONFIG_POSIX_MQUEUE=y
CONFIG_BSD_PROCESS_ACCT=y
CONFIG_LOG_BUF_SHIFT=14
CONFIG_BLK_DEV_INITRD=y
CONFIG_SYSCTL_SYSCALL=y
CONFIG_EMBEDDED=y
# CONFIG_VM_EVENT_COUNTERS is not set
CONFIG_SLAB=y
CONFIG_MODULES=y
CONFIG_MODULE_UNLOAD=y
# CONFIG_LBDAF is not set
# CONFIG_BLK_DEV_BSG is not set
# CONFIG_IOSCHED_DEADLINE is not set
# CONFIG_IOSCHED_CFQ is not set
# CONFIG_CMDLINE_IGNORE_DTB is not set
CONFIG_BOOT_LINK_OFFSET=0x00800000
CONFIG_ALTERA_REMOTE_UPDATE=y
CONFIG_NET=y
CONFIG_PACKET=y
CONFIG_UNIX=y
CONFIG_INET=y
# CONFIG_INET_XFRM_MODE_TRANSPORT is not set
# CONFIG_INET_XFRM_MODE_TUNNEL is not set
# CONFIG_INET_XFRM_MODE_BEET is not set
# CONFIG_INET_LRO is not set
# CONFIG_IPV6 is not set
# CONFIG_WIRELESS is not set
# CONFIG_FW_LOADER is not set
CONFIG_PROC_DEVICETREE=y
CONFIG_ALTERA_SYSID=y
CONFIG_NETDEVICES=y
CONFIG_MII=y
CONFIG_NET_VENDOR_ALTERA=y
CONFIG_ALT_TSE=y
# CONFIG_NET_VENDOR_BROADCOM is not set
# CONFIG_NET_VENDOR_CHELSIO is not set
# CONFIG_NET_VENDOR_INTEL is not set
# CONFIG_NET_VENDOR_MARVELL is not set
# CONFIG_NET_VENDOR_MICREL is not set
# CONFIG_NET_VENDOR_MICROCHIP is not set
# CONFIG_NET_VENDOR_NATSEMI is not set
# CONFIG_NET_VENDOR_SEEQ is not set
# CONFIG_NET_VENDOR_SMSC is not set
# CONFIG_NET_VENDOR_STMICRO is not set
CONFIG_MARVELL_PHY=y
# CONFIG_WLAN is not set
# CONFIG_INPUT is not set
# CONFIG_SERIO_I8042 is not set
# CONFIG_SERIO_SERPORT is not set
CONFIG_SERIO_ALTERA_PS2=y
# CONFIG_VT is not set
# CONFIG_LEGACY_PTYS is not set
# CONFIG_DEVKMEM is not set
CONFIG_SERIAL_ALTERA_JTAGUART=y
CONFIG_SERIAL_ALTERA_UART=y
CONFIG_SERIAL_ALTERA_UART_CONSOLE=y
# CONFIG_HW_RANDOM is not set
CONFIG_SPI=y
CONFIG_SPI_ALTERA=y
CONFIG_SPI_OC_TINY=y
CONFIG_GPIOLIB=y
CONFIG_GPIO_SYSFS=y
CONFIG_GPIO_ALTERA=y
CONFIG_GPIO_OC_BIT=y
# CONFIG_HWMON is not set
CONFIG_WATCHDOG=y
CONFIG_ALTERA_WDT=y
# CONFIG_USB_SUPPORT is not set
CONFIG_MMC=y
CONFIG_MMC_NIOS=y
# CONFIG_IOMMU_SUPPORT is not set
CONFIG_TMPFS=y
# CONFIG_MISC_FILESYSTEMS is not set
CONFIG_PRINTK_TIME=y
# CONFIG_ENABLE_WARN_DEPRECATED is not set
# CONFIG_SCHED_DEBUG is not set
CONFIG_DEBUG_INFO=y
CONFIG_KGDB=y
```

## nios2-linux/linux-2.6/arch/nios2/drivers/Kconfig
```kconfig
# Platfrom drivers configuration

menu "Additional Nios II Device Drivers"

config AVALON_DMA
	bool "Support for DMA controller with Avalon interface"
	help
	  Support the Altera DMA controller with Avalon interface, so drivers
	  for DMA-able devices can use this interface.

source "arch/nios2/drivers/pci/Kconfig"

config ALTERA_REMOTE_UPDATE
	bool "Remote update support"
	depends on NIOS2
	default N
	help
	  This driver provides support for automatic reconfiguration of a
	  Cyclone III FPGA (Possibly others too).

choice ALTERA_REMOTE_UPDATE_FLASH_WIDTH
	prompt "FPGA configuration flash data width"
	depends on ALTERA_REMOTE_UPDATE
	default ALTERA_REMOTE_UPDATE_FLASH_WIDTH_16
	help
	  The ALTREMOTE_UPDATE megafunction requires that you only provide it
	  the 22 highest-order bits of a 24-bit address offset.

	  This options controls the value by which the address offset of the
	  FPGA configuration image is shifted depending on the data width of
	  the flash where your image is stored.

	  EPCS flash data witdh is usually 8 bit
	  CFI flash data width is usually 16 bit

config ALTERA_REMOTE_UPDATE_FLASH_WIDTH_8
	bool "8 bits (shift address by 2)"
config ALTERA_REMOTE_UPDATE_FLASH_WIDTH_16
	bool "16 bits (shift address by 3)"
endchoice

endmenu
```
